## prj.conf
```kconfig
CONFIG_LOG=y
CONFIG_LOG_DEFAULT_LEVEL=3
# CONFIG_LOG_MODE_DEFERRED=y
CONFIG_LOG_MODE_IMMEDIATE=y
CONFIG_LOG_RATELIMIT=y
CONFIG_LOG_RATELIMIT_INTERVAL_MS=1000

CONFIG_THREAD_NAME=y
CONFIG_THREAD_MONITOR=y

CONFIG_SHELL=y
CONFIG_KERNEL_SHELL=y
CONFIG_SHELL_BACKEND_SERIAL=y
CONFIG_SHELL_LOG_BACKEND=y

CONFIG_INIT_STACKS=y
CONFIG_THREAD_STACK_INFO=y

CONFIG_SERIAL=y
CONFIG_CONSOLE=y
CONFIG_UART_CONSOLE=y
# CONFIG_UART_NATIVE_PTY_0_ON_OWN_PTY=y

CONFIG_TRACING=y
CONFIG_TRACING_CTF=y
CONFIG_TRACING_SYNC=y
CONFIG_TRACING_BACKEND_RAM=y
CONFIG_TRACING_BUFFER_SIZE=8192
# CONFIG_TRACING_BACKEND_POSIX=y
CONFIG_TRACING_PACKET_MAX_SIZE=64

CONFIG_MAIN_STACK_SIZE=2048
```

## src/main.c
```c
#include <zephyr/kernel.h>
#include <zephyr/logging/log.h>
#include <zephyr/tracing/tracing.h>

LOG_MODULE_REGISTER(homework, LOG_LEVEL_INF);

#define STACK_SIZE 2048
#define CONTROL_PRIORITY 4
#define MAINTENANCE_PRIORITY 7
#define EVENT_PERIOD_MS 250
#define MAINTENANCE_LOAD_US 45000
#define MAX_ALLOWED_LATENCY_MS 10

struct control_event {
  uint32_t seq;
  uint32_t ready_ms;
};

K_MSGQ_DEFINE(control_queue, sizeof(struct control_event), 4, 4);
K_SEM_DEFINE(maintenance_start, 0, 1);

/* ================================================================== */
/*  Timer expiry: creates one control event                           */
/* ================================================================== */

static void event_timer_expiry(struct k_timer *timer) {
  ARG_UNUSED(timer);

  static uint32_t seq;
  struct control_event event = {
      .seq = seq++,
      .ready_ms = k_uptime_get_32(),
  };

  /* Timer expiry runs in interrupt context, so never wait here. */
  int ret = k_msgq_put(&control_queue, &event, K_NO_WAIT);

  if (ret != 0) {
    return;
  }

  /* Both threads become ready when the timer interrupt returns. */
  k_sem_give(&maintenance_start);

  /* Add an application trace event for this sequence. */
  sys_trace_named_event("event_created", event.seq, event.ready_ms);
}

K_TIMER_DEFINE(event_timer, event_timer_expiry, NULL);

/* ================================================================== */
/*  Control thread                                                   */
/* ================================================================== */

static void control_fn(void *p1, void *p2, void *p3) {
  ARG_UNUSED(p1);
  ARG_UNUSED(p2);
  ARG_UNUSED(p3);

  uint32_t deadline_misses = 0;

  while (true) {
    struct control_event event;
    int ret = k_msgq_get(&control_queue, &event, K_FOREVER);

    if (ret != 0) {
      LOG_ERR("[CONTROL] receive failed: %d", ret);
      continue;
    }

    /* Define a response-time guarantee. */
    /* Measure latency and count every deadline miss. */
    /* Rate-limit repeated warning messages. */
    /* Add an application trace event for completion. */
    uint32_t now = k_uptime_get_32();
    uint32_t latency = now - event.ready_ms;

    if (latency > MAX_ALLOWED_LATENCY_MS) {
      deadline_misses++;
      /* Rate-limited warning (Slide 13) */
      LOG_WRN_RATELIMIT(
          "[CONTROL] Deadline missed! Latency: %u ms (Total misses: %u)",
          latency, deadline_misses);
    } else {
      LOG_INF("[CONTROL] Processed seq=%u (Latency: %u ms)", event.seq,
              latency);
    }

    sys_trace_named_event("control_done", event.seq, latency);
  }
}

/* ================================================================== */
/*  Background maintenance thread                                    */
/* ================================================================== */

static void maintenance_fn(void *p1, void *p2, void *p3) {
  ARG_UNUSED(p1);
  ARG_UNUSED(p2);
  ARG_UNUSED(p3);

  while (true) {
    k_sem_take(&maintenance_start, K_FOREVER);

    /* This work is important, but it has no short deadline. */
    k_busy_wait(MAINTENANCE_LOAD_US);
  }
}

K_THREAD_DEFINE(control, STACK_SIZE, control_fn, NULL, NULL, NULL,
                CONTROL_PRIORITY, 0, 0);

K_THREAD_DEFINE(maintenance, STACK_SIZE, maintenance_fn, NULL, NULL, NULL,
                MAINTENANCE_PRIORITY, 0, 0);

int main(void) {
  LOG_INF("=== L6 Homework: Runtime Investigation ===");
  LOG_INF("Control work must start within 10 ms");
  LOG_INF("Inspect, measure, trace, explain, and correct the delay");

  k_timer_start(&event_timer, K_MSEC(500), K_MSEC(EVENT_PERIOD_MS));

  return 0;
}
```

## src/sensor_bus.h
```c
#ifndef SENSOR_BUS_H_
#define SENSOR_BUS_H_

#include <zephyr/zbus/zbus.h>

struct sensor_msg {
  uint32_t seq;
  int16_t temperature;
};

ZBUS_CHAN_DECLARE(sensor_chan);

#endif /* SENSOR_BUS_H_ */
```
